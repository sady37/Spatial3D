/**
 * @cliArgs --device "XWRL684X" --part "Default" --package "FCCSP" --context "c66ss0" --product "MMWAVE-L-SDK-6@06.00.05"
 * @versions {"tool":"1.23.0+4000"}
 */

/**
 * Import the modules used in this configuration.
 */
const ipc       = scripting.addModule("/drivers/ipc/ipc");
const cache_c6x = scripting.addModule("/kernel/dpl/cache_c6x");
const clock     = scripting.addModule("/kernel/dpl/clock");
const debug_log = scripting.addModule("/kernel/dpl/debug_log");

/**
 * Write custom configuration values to the imported modules.
 */
cache_c6x.l1psize                           = 16;
cache_c6x.l1dsize                           = 16;
cache_c6x.marRegionConfig.create(1);
cache_c6x.marRegionConfig[0].$name          = "kernel_dpl_cache_c6x_mar0";
cache_c6x.marRegionConfig[0].baseAddr       = 0x88000000;
cache_c6x.marRegionConfig[0].enableCache    = true;
cache_c6x.marRegionConfig[0].enablePrefetch = true;

clock.DSPClockFreq = "SOC_C66CoreFreq400MHz";
